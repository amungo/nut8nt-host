
	ad9361@0 {
		#address-cells = <1>;
		#size-cells = <0>;
		#clock-cells = <1>;
		compatible = "adi,ad9361";

		/* SPI Setup */
		reg = <0x0>;
		spi-cpha;
		spi-max-frequency = <5000000>;
		
		/* Clocks */
		clocks = <&ad9361_clkin 0>;
		clock-names = "ad9361_ext_refclk";
		clock-output-names = "rx_sampl_clk", "tx_sampl_clk";

		// adi,rx-path-clock-frequencies = <1280000000 160000000 80000000 40000000 40000000 40000000>;
		// adi,tx-path-clock-frequencies = <1280000000 160000000 80000000 40000000 40000000 40000000>;


		/* Base Configuration */
		adi,2rx-2tx-mode-enable =									<0>;
		adi,1rx-1tx-mode-use-rx-num =								<0>;
		adi,1rx-1tx-mode-use-tx-num =								<0>;
		adi,frequency-division-duplex-mode-enable =					<1>;
		adi,frequency-division-duplex-independent-mode-enable =		<0>;
		adi,tdd-use-dual-synth-mode-enable =						<0>;
		adi,tdd-skip-vco-cal-enable =								<0>;
		adi,tx-fastlock-delay-ns =									<0>;
		adi,rx-fastlock-delay-ns =									<0>;
		adi,rx-fastlock-pincontrol-enable =							<0>;
		adi,tx-fastlock-pincontrol-enable =							<0>;
		adi,external-rx-lo-enable =									<0>;
		adi,external-tx-lo-enable =									<0>;
		adi,dc-offset-tracking-update-event-mask =					<5>;
		adi,dc-offset-attenuation-high-range =						<6>;
		adi,dc-offset-attenuation-low-range =						<5>;
		adi,dc-offset-count-high-range =							<0x28>;
		adi,dc-offset-count-low-range =								<0x32>;
		adi,split-gain-table-mode-enable =							<0>;
		/*adi,trx-synthesizer-target-fref-overwrite-hz =				<MAX_SYNTH_FREF>;*/
		adi,qec-tracking-slow-mode-enable =							<0>;
		/* ENSM Control */
		adi,ensm-enable-pin-pulse-mode-enable =						<0>;
		adi,ensm-enable-txnrx-control-enable =						<0>;
		/* LO Control */
		adi,rx-synthesizer-frequency-hz =							<1590000000UL>;
		adi,tx-synthesizer-frequency-hz =							<1590000000UL>;
		adi,tx-lo-powerdown-managed-enable =						<1>;
		/* Rate & BW Control */
		adi,rx-path-clock-frequencies =								<1280000000 160000000 80000000 40000000 40000000 40000000>;
		adi,tx-path-clock-frequencies =								<1280000000 160000000 80000000 40000000 40000000 40000000>;
		adi,rf-rx-bandwidth-hz =									<20172411>;
		adi,rf-tx-bandwidth-hz =									<56000000>;
		/* RF Port Control */
		adi,rx-rf-port-input-select =								<1>;
		adi,tx-rf-port-input-select =								<0>;
		/* TX Attenuation Control */
		adi,tx-attenuation-mdB =									<10000>;
		adi,update-tx-gain-in-alert-enable =						<0>;
		/* Reference Clock Control */
		adi,xo-disable-use-ext-refclk-enable =						<1>;
		adi,dcxo-coarse-and-fine-tune =								<8 5920>;
		adi,clk-output-mode-select =								<0>;
		/* Gain Control */
		adi,gc-rx1-mode =											<2>;
		adi,gc-rx2-mode =											<2>;
		adi,gc-adc-large-overload-thresh =							<58>;
		adi,gc-adc-ovr-sample-size =								<4>;
		adi,gc-adc-small-overload-thresh =							<47>;
		adi,gc-dec-pow-measurement-duration =						<8192>;
		adi,gc-dig-gain-enable =									<0>;
		adi,gc-lmt-overload-high-thresh =							<800>;
		adi,gc-lmt-overload-low-thresh =							<704>;
		adi,gc-low-power-thresh =									<24>;
		adi,gc-max-dig-gain =										<15>;
		/* Gain MGC Control */
		adi,mgc-dec-gain-step =										<2>;
		adi,mgc-inc-gain-step =										<2>;
		adi,mgc-rx1-ctrl-inp-enable =								<0>;
		adi,mgc-rx2-ctrl-inp-enable =								<0>;
		adi,mgc-split-table-ctrl-inp-gain-mode =					<0>;
		/* Gain AGC Control */
		adi,agc-adc-large-overload-exceed-counter =					<10>;
		adi,agc-adc-large-overload-inc-steps =						<2>;
		adi,agc-adc-lmt-small-overload-prevent-gain-inc-enable =	<0>;
		adi,agc-adc-small-overload-exceed-counter =					<10>;
		adi,agc-dig-gain-step-size =								<4>;
		adi,agc-dig-saturation-exceed-counter =						<3>;
		adi,agc-gain-update-interval-us =							<1000>;
		adi,agc-immed-gain-change-if-large-adc-overload-enable =	<0>;
		adi,agc-immed-gain-change-if-large-lmt-overload-enable =	<0>;
		adi,agc-inner-thresh-high =									<10>;
		adi,agc-inner-thresh-high-dec-steps =						<1>;
		adi,agc-inner-thresh-low =									<12>;
		adi,agc-inner-thresh-low-inc-steps =						<1>;
		adi,agc-lmt-overload-large-exceed-counter =					<10>;
		adi,agc-lmt-overload-large-inc-steps =						<2>;
		adi,agc-lmt-overload-small-exceed-counter =					<10>;
		adi,agc-outer-thresh-high =									<5>;
		adi,agc-outer-thresh-high-dec-steps =						<2>;
		adi,agc-outer-thresh-low =									<18>;
		adi,agc-outer-thresh-low-inc-steps =						<2>;
		adi,agc-attack-delay-extra-margin-us =						<1>;
		adi,agc-sync-for-gain-counter-enable =						<0>;
		/* Fast AGC */
		adi,fagc-dec-pow-measurement-duration =						<64>;
		adi,fagc-state-wait-time-ns =								<260>;
		/* Fast AGC - Low Power */
		adi,fagc-allow-agc-gain-increase-enable =					<0>;
		adi,fagc-lp-thresh-increment-time =							<5>;
		adi,fagc-lp-thresh-increment-steps =						<1>;
		/* Fast AGC - Lock Level (Lock Level is set via slow AGC inner high threshold) */
		adi,fagc-lock-level-lmt-gain-increase-enable =				<1>;
		adi,fagc-lock-level-gain-increase-upper-limit =				<5>;
		/* Fast AGC - Peak Detectors and Final Settling */
		adi,fagc-lpf-final-settling-steps =							<1>;
		adi,fagc-lmt-final-settling-steps =							<1>;
		adi,fagc-final-overrange-count =							<3>;
		/* Fast AGC - Final Power Test */
		adi,fagc-gain-increase-after-gain-lock-enable =				<0>;
		/* Fast AGC - Unlocking the Gain */
		adi,fagc-gain-index-type-after-exit-rx-mode =				<0>;
		adi,fagc-use-last-lock-level-for-set-gain-enable =			<1>;
		adi,fagc-rst-gla-stronger-sig-thresh-exceeded-enable =		<1>;
		adi,fagc-optimized-gain-offset =							<5>;
		adi,fagc-rst-gla-stronger-sig-thresh-above-ll =				<10>;
		adi,fagc-rst-gla-engergy-lost-sig-thresh-exceeded-enable =	<1>;
		adi,fagc-rst-gla-engergy-lost-goto-optim-gain-enable =		<1>;
		adi,fagc-rst-gla-engergy-lost-sig-thresh-below-ll =			<10>;
		adi,fagc-energy-lost-stronger-sig-gain-lock-exit-cnt =		<8>;
		adi,fagc-rst-gla-large-adc-overload-enable =				<1>;
		adi,fagc-rst-gla-large-lmt-overload-enable =				<1>;
		adi,fagc-rst-gla-en-agc-pulled-high-enable =				<0>;
		adi,fagc-rst-gla-if-en-agc-pulled-high-mode =				<0>;
		adi,fagc-power-measurement-duration-in-state5 =				<64>;
		/* RSSI Control */
		adi,rssi-delay =											<1>;
		adi,rssi-duration =											<1000>;
		adi,rssi-restart-mode =										<3>;
		adi,rssi-unit-is-rx-samples-enable =						<0>;
		adi,rssi-wait =												<1>;
		/* Aux ADC Control */
		adi,aux-adc-decimation =									<256>;
		adi,aux-adc-rate =											<40000000UL>;
		/* AuxDAC Control */
		adi,aux-dac-manual-mode-enable =							<1>;
		adi,aux-dac1-default-value-mV =								<0>;
		adi,aux-dac1-active-in-rx-enable =							<0>;
		adi,aux-dac1-active-in-tx-enable =							<0>;
		adi,aux-dac1-active-in-alert-enable =						<0>;
		adi,aux-dac1-rx-delay-us =									<0>;
		adi,aux-dac1-tx-delay-us =									<0>;
		adi,aux-dac2-default-value-mV =								<0>;
		adi,aux-dac2-active-in-rx-enable =							<0>;
		adi,aux-dac2-active-in-tx-enable =							<0>;
		adi,aux-dac2-active-in-alert-enable =						<0>;
		adi,aux-dac2-rx-delay-us =									<0>;
		adi,aux-dac2-tx-delay-us =									<0>;
		/* Temperature Sensor Control */
		adi,temp-sense-decimation =									<256>;
		adi,temp-sense-measurement-interval-ms =					<1000>;
		adi,temp-sense-offset-signed =								<0xCE>;
		adi,temp-sense-periodic-measurement-enable =				<1>;
		/* Control Out Setup */
		adi,ctrl-outs-enable-mask =									<0xFF>;
		adi,ctrl-outs-index =										<0>;
		/* External LNA Control */
		adi,elna-settling-delay-ns =								<0>;
		adi,elna-gain-mdB =											<0>;
		adi,elna-bypass-loss-mdB =									<0>;
		adi,elna-rx1-gpo0-control-enable =							<0>;
		adi,elna-rx2-gpo1-control-enable =							<0>;
		adi,elna-gaintable-all-index-enable =						<0>;
		/* Digital Interface Control */
		adi,digital-interface-tune-skip-mode =						<0>;
		adi,digital-interface-tune-fir-disable =					<0>;
		adi,pp-tx-swap-enable =										<0>;
		adi,pp-rx-swap-enable =										<0>;
		adi,tx-channel-swap-enable =								<0>;
		adi,rx-channel-swap-enable =								<0>;
		adi,rx-frame-pulse-mode-enable =							<1>;
		adi,2t2r-timing-enable =									<0>;
		adi,invert-data-bus-enable =								<0>;
		adi,invert-data-clk-enable =								<0>;
		adi,fdd-alt-word-order-enable =								<0>;
		adi,invert-rx-frame-enable =								<0>;
		adi,fdd-rx-rate-2tx-enable =								<0>;
		adi,swap-ports-enable =										<0>;
		adi,single-data-rate-enable =								<0>;
		adi,lvds-mode-enable =										<0>;
		adi,half-duplex-mode-enable =								<0>;
		adi,single-port-mode-enable =								<0>;
		adi,full-port-enable =										<1>;
		adi,full-duplex-swap-bits-enable =							<0>;
		adi,delay-rx-data =											<0>;
		adi,rx-data-clock-delay =									<0>;
		adi,rx-data-delay =											<4>;
		adi,tx-fb-clock-delay =										<7>;
		adi,tx-data-delay =											<0>;
		adi,lvds-bias-mV =											<150>;
		adi,lvds-rx-onchip-termination-enable =						<0>;
		adi,rx1-rx2-phase-inversion-enable =						<0>;
		adi,lvds-invert1-control =									<0xFF>;
		adi,lvds-invert2-control =									<0x0F>;
		/* GPO Control */
		adi,gpo0-inactive-state-high-enable =						<0>;
		adi,gpo1-inactive-state-high-enable =						<0>;
		adi,gpo2-inactive-state-high-enable =						<0>;
		adi,gpo3-inactive-state-high-enable =						<0>;
		adi,gpo0-slave-rx-enable =									<0>;
		adi,gpo0-slave-tx-enable =									<0>;
		adi,gpo1-slave-rx-enable =									<0>;
		adi,gpo1-slave-tx-enable =									<0>;
		adi,gpo2-slave-rx-enable =									<0>;
		adi,gpo2-slave-tx-enable =									<0>;
		adi,gpo3-slave-rx-enable =									<0>;
		adi,gpo3-slave-tx-enable =									<0>;
		adi,gpo0-rx-delay-us =										<0>;
		adi,gpo0-tx-delay-us =										<0>;
		adi,gpo1-rx-delay-us =										<0>;
		adi,gpo1-tx-delay-us =										<0>;
		adi,gpo2-rx-delay-us =										<0>;
		adi,gpo2-tx-delay-us =										<0>;
		adi,gpo3-rx-delay-us =										<0>;
		adi,gpo3-tx-delay-us =										<0>;
		/* Tx Monitor Control */
		adi,txmon-low-high-thresh =									<37000>;
		adi,txmon-low-gain =										<0>;
		adi,txmon-high-gain =										<24>;
		adi,txmon-dc-tracking-enable =								<0>;
		adi,txmon-one-shot-mode-enable =							<0>;
		adi,txmon-delay =											<511>;
		adi,txmon-duration =										<8192>;
		adi,txmon-1-front-end-gain =								<2>;
		adi,txmon-2-front-end-gain =								<2>;
		adi,txmon-1-lo-cm =											<48>;
		adi,txmon-2-lo-cm =											<48>;
	};